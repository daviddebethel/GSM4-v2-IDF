## firmware/main/Kconfig.projbuild
```kconfig
menu "GSM4 Build Profile"

choice GSM4_BUILD_PROFILE
    prompt "Build profile contract"
    default GSM4_BUILD_PROFILE_DEV
    help
        Select one build profile from the agreed Option 2 contract.

config GSM4_BUILD_PROFILE_DEV
    bool "dev"

config GSM4_BUILD_PROFILE_CI_TEST
    bool "ci-test"

config GSM4_BUILD_PROFILE_CI_SECURE
    bool "ci-secure"

config GSM4_BUILD_PROFILE_RELEASE
    bool "release"

endchoice

config GSM4_BUILD_PROFILE_NAME
    string
    default "dev" if GSM4_BUILD_PROFILE_DEV
    default "ci-test" if GSM4_BUILD_PROFILE_CI_TEST
    default "ci-secure" if GSM4_BUILD_PROFILE_CI_SECURE
    default "release" if GSM4_BUILD_PROFILE_RELEASE

config GSM4_TEST_HARNESS_MODE
    bool "Enable test harness hooks"
    default y if GSM4_BUILD_PROFILE_DEV || GSM4_BUILD_PROFILE_CI_TEST
    default n
    help
        Enables deterministic test seam wiring and mock injection hooks.
        Should remain disabled for ci-secure and release builds.

config GSM4_SERIAL_DEBUG_ENABLED
    bool "Enable serial debug stream"
    default y if GSM4_BUILD_PROFILE_DEV || GSM4_BUILD_PROFILE_CI_TEST
    default n
    help
        Controls serial debug output in application code. This must be off for
        release-safe profiles unless explicitly enabled for controlled service use.

config GSM4_RUNTIME_DEBUG_WEB_DEFAULT_ON
    bool "Enable runtime web debug channels by default"
    default n
    help
        Policy default for runtime web debug channels. Release requires default-off.

config GSM4_PHASE0_TELEMETRY
    bool "Enable Phase 0 telemetry loop (1 Hz)"
    default n
    help
        Emits 1 Hz Phase 0 bring-up telemetry for charger and interrupt lines.
        Keep disabled in release-safe profiles unless explicitly required.

config GSM4_RELEASE_SAFE_DEFAULTS
    bool
    default y if GSM4_BUILD_PROFILE_CI_SECURE || GSM4_BUILD_PROFILE_RELEASE
    default n

config GSM4_SERIAL_DEBUG_LOCKDOWN
    bool
    default y if GSM4_BUILD_PROFILE_RELEASE
    default n

config GSM4_REQUIRE_RELEASE_SECURITY_CONTROLS
    bool
    default y if GSM4_BUILD_PROFILE_CI_SECURE || GSM4_BUILD_PROFILE_RELEASE
    default n

endmenu
```

## firmware/sdkconfig.defaults
```kconfig
# Shared defaults for all build profiles.
#
# Profile-specific overlays are provided in:
# - sdkconfig.defaults.dev
# - sdkconfig.defaults.ci-test
# - sdkconfig.defaults.ci-secure
# - sdkconfig.defaults.release

CONFIG_GSM4_BUILD_PROFILE_DEV=y

# Safe baseline: runtime web debug channels are default-off in all profiles.
CONFIG_GSM4_RUNTIME_DEBUG_WEB_DEFAULT_ON=n

# Flash and partition baseline for ESP32-WROOM-32E (16MB).
CONFIG_ESPTOOLPY_FLASHSIZE_16MB=y
CONFIG_ESPTOOLPY_FLASHSIZE="16MB"
CONFIG_PARTITION_TABLE_CUSTOM=y
CONFIG_PARTITION_TABLE_CUSTOM_FILENAME="partitions_16mb.csv"
CONFIG_PARTITION_TABLE_FILENAME="partitions_16mb.csv"

# Web assets require long filenames in FATFS images.
CONFIG_FATFS_LFN_HEAP=y
```

## firmware/sdkconfig.defaults.ci-secure
```kconfig
# CI secure profile defaults.
CONFIG_GSM4_BUILD_PROFILE_CI_SECURE=y
CONFIG_GSM4_TEST_HARNESS_MODE=n
CONFIG_GSM4_SERIAL_DEBUG_ENABLED=n
CONFIG_GSM4_RELEASE_SAFE_DEFAULTS=y
CONFIG_GSM4_REQUIRE_RELEASE_SECURITY_CONTROLS=y

CONFIG_LOG_DEFAULT_LEVEL_WARN=y
CONFIG_LOG_DEFAULT_LEVEL=2
CONFIG_LOG_MAXIMUM_LEVEL_INFO=y
CONFIG_LOG_MAXIMUM_LEVEL=3
```

## firmware/sdkconfig.defaults.ci-test
```kconfig
# CI test profile defaults.
CONFIG_GSM4_BUILD_PROFILE_CI_TEST=y
CONFIG_GSM4_TEST_HARNESS_MODE=y
CONFIG_GSM4_SERIAL_DEBUG_ENABLED=y

CONFIG_LOG_DEFAULT_LEVEL_INFO=y
CONFIG_LOG_DEFAULT_LEVEL=3
CONFIG_LOG_MAXIMUM_LEVEL_DEBUG=y
CONFIG_LOG_MAXIMUM_LEVEL=4
```

## firmware/sdkconfig.defaults.dev
```kconfig
# Development profile defaults.
CONFIG_GSM4_BUILD_PROFILE_DEV=y
CONFIG_GSM4_TEST_HARNESS_MODE=y
CONFIG_GSM4_SERIAL_DEBUG_ENABLED=y

CONFIG_LOG_DEFAULT_LEVEL_DEBUG=y
CONFIG_LOG_DEFAULT_LEVEL=4
CONFIG_LOG_MAXIMUM_LEVEL_DEBUG=y
CONFIG_LOG_MAXIMUM_LEVEL=4
```

## firmware/sdkconfig.defaults.release
```kconfig
# Release profile defaults.
CONFIG_GSM4_BUILD_PROFILE_RELEASE=y
CONFIG_GSM4_TEST_HARNESS_MODE=n
CONFIG_GSM4_SERIAL_DEBUG_ENABLED=n
CONFIG_GSM4_RELEASE_SAFE_DEFAULTS=y
CONFIG_GSM4_SERIAL_DEBUG_LOCKDOWN=y
CONFIG_GSM4_REQUIRE_RELEASE_SECURITY_CONTROLS=y

CONFIG_LOG_DEFAULT_LEVEL_WARN=y
CONFIG_LOG_DEFAULT_LEVEL=2
CONFIG_LOG_MAXIMUM_LEVEL_WARN=y
CONFIG_LOG_MAXIMUM_LEVEL=2
```
